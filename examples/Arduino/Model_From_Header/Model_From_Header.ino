// SPDX-FileCopyrightText: 2026 Eric Nam
// SPDX-License-Identifier: Apache-2.0
//
// a3d on Arduino: a real container, a skeleton and a clip - with no file
// system and no EMBED_FILES.
//
// ---------------------------------------------------------------------------
// THE ASSET PROBLEM, WHICH IS ARDUINO-SPECIFIC
//
// On ESP-IDF a .a3d goes into the firmware with EMBED_FILES and a3d reads it
// in place out of memory-mapped flash. The Arduino IDE has no equivalent, so
// there are exactly two routes and this example takes the first:
//
//   1. a byte array compiled into the sketch:
//        python3 tools/a3d_export.py --header model.a3d -o model_a3d.h
//      then openAsset(). `model_a3d.h` here was generated by that command
//      from  `--skinned 4 --segments 8 --bones 4`. The generated array is
//      4-byte ALIGNED on purpose: a3d casts the base pointer to the file
//      header, and an unaligned container fails on the board rather than at
//      compile time.
//
//   2. a file, with openAssetFile("/sd/model.a3d"). a3d's stdio loader is
//      plain fopen and the Arduino cores register VFS mounts, so the stock
//      SD and LittleFS libraries work - call SD.begin() first.
//
// Start from a .glb with:
//      python3 tools/a3d_export.py --check model.glb
// ---------------------------------------------------------------------------
// WHERE THE MEMORY GOES, WHICH IS ALSO ARDUINO-SPECIFIC
//
// The Arduino core sets CONFIG_SPIRAM_MALLOC_ALWAYSINTERNAL to 4096, so on a
// board with PSRAM every allocation above 4 KB goes to PSRAM by default -
// including the tile framebuffers the rasterizer writes for EVERY pixel of
// EVERY frame. That is the wrong memory for them. setAllocator() below puts
// them back in internal RAM; setLargeAllocator() leaves the bulk geometry,
// which is read once per triangle rather than per pixel, wherever malloc
// wants it.
// ---------------------------------------------------------------------------

#include <a3d.h>
#include <esp_heap_caps.h>

#include "model_a3d.h"

static const int VIEW_W = 240;
static const int VIEW_H = 320;

static a3d::Viewer   viewer;
static a3d::Display  display;
static a3d::FreeRtosExecutor executor(A3D_CONFIG_MAX_WORKERS);

static volatile uint32_t g_ink = 0;

static void sendTile(void*, const uint16_t* src, int, int, int w, int h)
    {
    uint32_t ink = 0;
    const int n = w * h;
    for (int i = 0; i < n; ++i)
        if (src[i] != 0x0000) ++ink;
    g_ink += ink;
    }

static uint64_t nowUs(void*) { return (uint64_t)esp_timer_get_time(); }

// Internal and DMA-capable: this is the memory the rasterizer touches per
// pixel and the memory a panel driver will want to DMA from.
static void* fastAlloc(size_t n)
    { return heap_caps_malloc(n, MALLOC_CAP_INTERNAL | MALLOC_CAP_8BIT); }
static void  fastFree(void* p) { heap_caps_free(p); }

void setup()
    {
    Serial.begin(115200);
    delay(400);
    Serial.printf("\n[a3d] board=%s workers=%d psram=%s\n",
                  A3D_BOARD_NAME, A3D_CONFIG_MAX_WORKERS,
                  psramFound() ? "yes" : "no");

    display.width    = VIEW_W;
    display.height   = VIEW_H;
    display.name     = "offscreen";
    display.sendTile = sendTile;

    a3d::ViewerConfig cfg;
    cfg.tileHeight = 40;

    // Everything in this block is read by begin(), so it comes first.
    viewer.setExecutor(executor);
    viewer.setClock(nowUs, nullptr);
    viewer.setAllocator(fastAlloc, fastFree);   // tile colour + depth
    // setLargeAllocator() is left alone: the decoded vertex buffers of a
    // SKINNED mesh are rewritten every frame, so PSRAM is not obviously right
    // for them either. Measure before moving them.

    if (!viewer.begin(display, cfg))
        { Serial.printf("[a3d] begin failed: %s\n", viewer.error()); return; }

    if (!viewer.openAsset(model_a3d, model_a3d_len))
        {
        Serial.printf("[a3d] openAsset failed: %s\n", viewer.error());
        Serial.println("[a3d] a container that fails here is usually misaligned "
                       "or truncated; regenerate with --header.");
        return;
        }
    viewer.frameModel();

    Serial.printf("[a3d] %lu triangles, %lu clip(s)\n",
                  (unsigned long)viewer.triangleCount(),
                  (unsigned long)viewer.clipCount());
    if (viewer.clipCount() > 0)
        {
        viewer.selectClip(0);
        viewer.setPlaying(true);
        Serial.printf("[a3d] playing %s (%.0f ms)\n",
                      viewer.clipName(), viewer.clipDurationMs());
        }
    }

void loop()
    {
    if (!viewer.ready()) { delay(1000); return; }

    static uint64_t lastUs = 0;
    const uint64_t t0 = nowUs(nullptr);
    const float dtMs = (lastUs == 0) ? 16.0f : (float)(t0 - lastUs) / 1000.0f;
    lastUs = t0;

    // dtMs is what advances the clip, so the animation runs at real speed
    // whatever the frame rate happens to be.
    viewer.frame(dtMs);
    viewer.orbit(0.02f, 0.0f);

    // The one thing worth saying out loud, once: a renderer that draws nothing
    // passes every other check there is, and on a board with no panel attached
    // this is the only way to tell "it worked" from "it ran".
    static bool reported = false;
    if (!reported && (viewer.stats().frames > 4))
        {
        reported = true;
        if (g_ink > 0)
            Serial.printf("[a3d] drawing: %lu lit pixels reached sendTile\n",
                          (unsigned long)g_ink);
        else
            Serial.println("[a3d] WARNING: nothing reached sendTile. "
                           "Nothing was drawn.");
        }
    }
